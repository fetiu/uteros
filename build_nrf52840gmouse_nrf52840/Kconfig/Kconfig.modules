## build_nrf52840gmouse_nrf52840/Kconfig/Kconfig.modules
```kconfig
menu "nrf (D:/ncs/v1.9.1/nrf)"
osource "D:/ncs/v1.9.1/nrf/Kconfig.nrf"
config ZEPHYR_NRF_MODULE
	bool
	default y
endmenu
menu "mcuboot (D:/ncs/v1.9.1/bootloader/mcuboot)"
osource "$(ZEPHYR_MCUBOOT_KCONFIG)"
config ZEPHYR_MCUBOOT_MODULE
	bool
	default y
endmenu
menu "mbedtls (D:/ncs/v1.9.1/mbedtls)"
osource "$(ZEPHYR_MBEDTLS_KCONFIG)"
config ZEPHYR_MBEDTLS_MODULE
	bool
	default y
endmenu
menu "trusted-firmware-m (D:/ncs/v1.9.1/modules/tee/tf-m/trusted-firmware-m)"
osource "$(ZEPHYR_TRUSTED_FIRMWARE_M_KCONFIG)"
config ZEPHYR_TRUSTED_FIRMWARE_M_MODULE
	bool
	default y
endmenu
menu "cjson (D:/ncs/v1.9.1/modules/lib/cjson)"
osource "$(ZEPHYR_CJSON_KCONFIG)"
config ZEPHYR_CJSON_MODULE
	bool
	default y
endmenu
menu "cddl-gen (D:/ncs/v1.9.1/modules/lib/cddl-gen)"
osource "$(ZEPHYR_CDDL_GEN_KCONFIG)"
config ZEPHYR_CDDL_GEN_MODULE
	bool
	default y
endmenu
menu "memfault-firmware-sdk (D:/ncs/v1.9.1/modules/lib/memfault-firmware-sdk)"
osource "D:/ncs/v1.9.1/modules/lib/memfault-firmware-sdk/ports/zephyr/Kconfig"
config ZEPHYR_MEMFAULT_FIRMWARE_SDK_MODULE
	bool
	default y
endmenu
menu "CANopenNode (D:/ncs/v1.9.1/modules/lib/canopennode)"
osource "$(ZEPHYR_CANOPENNODE_KCONFIG)"
config ZEPHYR_CANOPENNODE_MODULE
	bool
	default y
endmenu
menu "hal_nordic (D:/ncs/v1.9.1/modules/hal/nordic)"
osource "$(ZEPHYR_HAL_NORDIC_KCONFIG)"
config ZEPHYR_HAL_NORDIC_MODULE
	bool
	default y
endmenu
menu "loramac-node (D:/ncs/v1.9.1/modules/lib/loramac-node)"
osource "$(ZEPHYR_LORAMAC_NODE_KCONFIG)"
config ZEPHYR_LORAMAC_NODE_MODULE
	bool
	default y
endmenu
menu "lz4 (D:/ncs/v1.9.1/modules/lib/lz4)"
osource "$(ZEPHYR_LZ4_KCONFIG)"
config ZEPHYR_LZ4_MODULE
	bool
	default y
endmenu
menu "mbedtls (D:/ncs/v1.9.1/modules/crypto/mbedtls)"
osource "$(ZEPHYR_MBEDTLS_KCONFIG)"
config ZEPHYR_MBEDTLS_MODULE
	bool
	default y
endmenu
menu "nanopb (D:/ncs/v1.9.1/modules/lib/nanopb)"
osource "$(ZEPHYR_NANOPB_KCONFIG)"
config ZEPHYR_NANOPB_MODULE
	bool
	default y
endmenu
menu "TraceRecorder (D:/ncs/v1.9.1/modules/debug/TraceRecorder)"
osource "D:/ncs/v1.9.1/modules/debug/TraceRecorder/kernelports/Zephyr/Kconfig"
config ZEPHYR_TRACERECORDER_MODULE
	bool
	default y
endmenu
menu "zscilib (D:/ncs/v1.9.1/modules/lib/zscilib)"
osource "D:/ncs/v1.9.1/modules/lib/zscilib/Kconfig.zscilib"
config ZEPHYR_ZSCILIB_MODULE
	bool
	default y
endmenu
menu "nrfxlib (D:/ncs/v1.9.1/nrfxlib)"
osource "D:/ncs/v1.9.1/nrfxlib/Kconfig.nrfxlib"
config ZEPHYR_NRFXLIB_MODULE
	bool
	default y
endmenu
menu "connectedhomeip (D:/ncs/v1.9.1/modules/lib/matter)"
osource "D:/ncs/v1.9.1/modules/lib/matter/config/nrfconnect/chip-module/Kconfig"
config ZEPHYR_CONNECTEDHOMEIP_MODULE
	bool
	default y
endmenu
```
